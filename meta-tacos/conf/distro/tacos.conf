## meta-tacos/conf/distro/tacos.conf
```bitbake
DISTRO = "tacos"
DISTRO_NAME = "TACOS"
DISTRO_VERSION = "1.0.1"

DISTRO_FEATURES ?= "${DISTRO_FEATURES_DEFAULT} sysvinit usbgadget usbhost"
DISTRO_EXTRA_RDEPENDS += "packagegroup-core-boot"

PREFERRED_VERSION_linux-yocto ?= "6.12%"
PREFERRED_VERSION_linux-yocto-rt ?= "6.12%"

#DO NOT set preferred version like this
# PREFERRED_VERSION_linux-bb.org ?= "6.12%"

# SDK_VERSION = "${@d.getVar('DISTRO_VERSION').replace('snapshot-${METADATA_REVISION}', 'snapshot')}"
# SDK_NAME = "${DISTRO}-${TCLIBC}-${SDKMACHINE}-${IMAGE_BASENAME}-${TUNE_PKGARCH}-${MACHINE}"
# SDKPATHINSTALL = "/opt/${DISTRO}/${SDK_VERSION}"

PACKAGE_CLASSES ?= "package_ipk"

TARGET_VENDOR = "-tacos"

SANITY_TESTED_DISTROS ?= "\
    beskar \n \
    debian-12 \n \
    tacos \n \
    "
```

## meta-tacos/conf/layer.conf
```bitbake
# We have a conf and classes directory, add to BBPATH
BBPATH .= ":${LAYERDIR}"

# We have recipes-* directories, add to BBFILES
BBFILES += "${LAYERDIR}/recipes-*/*/*.bb \
            ${LAYERDIR}/recipes-*/*/*.bbappend"

BBFILE_COLLECTIONS += "meta-tacos"
BBFILE_PATTERN_meta-tacos = "^${LAYERDIR}/"
BBFILE_PRIORITY_meta-tacos = "10"

LAYERDEPENDS_meta-tacos = "core"
LAYERSERIES_COMPAT_meta-tacos = "whinlatter"
```

## meta-tacos/conf/machine/bleedingbone.conf
```bitbake
#@TYPE: Machine
#@NAME: BeagleBone machine
#@DESCRIPTION: Machine configuration for the http://beagleboard.org/bone board with kernel 6.12 support
#@VERSION: 1.0

MACHINEOVERRIDES =. "beaglebone:"

require conf/machine/beaglebone.conf
#At this point, we can simply rename the include file to beagle-bsp.inc and expect it to work
#since beaglebone.conf includes it and meta-tacos has higher BBFILE priority
#However, for cleanliness and Readability we will keep a separate name for the include file and
#include it again.
require conf/machine/include/bone-kernel.inc
require conf/machine/include/ti-firmware-src.inc

IMAGE_FSTYPES += "wic ext4"

QB_SYSTEM_NAME = "qemu-system-arm"
```

## meta-tacos/conf/machine/include/ti-firmware-src.inc
```bitbake
# Change ti firmware source as original link is non-functional
TI_LINUX_FW_GIT_URI:layer-meta-ti-bsp = "git://github.com/beagleboard/ti-linux-firmware.git"
```
